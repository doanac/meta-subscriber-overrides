## conf/machine/include/lmp-factory-custom.inc
```bitbake
# LMP factory specific customizations (either replace or extend options as defined by meta-lmp)

KERNEL_FEATURES_append = " features/nfsd/nfsd-enable.scc"
```
